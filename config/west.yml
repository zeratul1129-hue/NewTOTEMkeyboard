## config/west.yml
```yaml
manifest:
  remotes:
    - name: zmkfirmware
      url-base: https://github.com/zmkfirmware
    - name: caksoylar
      url-base: https://github.com/caksoylar
  projects:
    - name: zmk
      remote: zmkfirmware
      revision: v0.3-branch  # <-- 해시값 대신 브랜치 이름을 입력합니다.
      import: app/west.yml
    - name: zmk-rgbled-widget
      remote: caksoylar
      revision: main     
  self:
    path: config
```
